#include <JeeLib.h>
#include <GLCD_ST7565.h>

#include "font_metric01.h"
#include "font_metric02.h"
#include "font_metric04.h"

GLCD_ST7565 glcd;

void setup()
{
	glcd.begin(0x19);
  	glcd.backLight(255);  	
}


static uint8_t image_data_Rad[32] PROGMEM = {
	0xfc, 0x03, 0x03, 0xfc, 0x03, 0x03, 0xfc, 0x03, 0x03, 0xfc, 0x03, 0x03, 0xfc, 0x03, 0x03, 0xfc, 0x3f, 0xc0, 0xc0, 0x3f, 0xc0, 0xc0, 0x3f, 0xc0, 0xc0, 0x3f, 0xc0, 0xc0, 0x3f, 0xc0, 0xc0, 0x3f
};

static uint8_t image_data_Heat[2][2] PROGMEM = {
	{0xaa, 0x55},
	{0x55, 0xaa}
};

static uint8_t image_data_Pump[4][32] PROGMEM = {
	{
		0xc0, 0x30, 0x08, 0x04, 0x82, 0xe2, 0xf9, 0xff, 0xff, 0xf9, 0xe2, 0x82, 0x04, 0x08, 0x30, 0xc0, 0x03, 0x0c, 0x18, 0x2e, 0x4f, 0x4f, 0x8f, 0x8f, 0x8f, 0x8f, 0x4f, 0x4f, 0x2e, 0x18, 0x0c, 0x03
	},
	{
		0xc0, 0x30, 0x08, 0x04, 0xfe, 0xfa, 0xf9, 0xf1, 0xf1, 0xe1, 0xe2, 0xc2, 0xc4, 0x88, 0xb0, 0xc0, 0x03, 0x0c, 0x10, 0x20, 0x7f, 0x5f, 0x9f, 0x8f, 0x8f, 0x87, 0x47, 0x43, 0x23, 0x11, 0x0d, 0x03
	},
	{
		0xc0, 0x30, 0x18, 0x74, 0xf2, 0xf2, 0xf1, 0xf1, 0xf1, 0xf1, 0xf2, 0xf2, 0x74, 0x18, 0x30, 0xc0, 0x03, 0x0c, 0x10, 0x20, 0x41, 0x47, 0x9f, 0xff, 0xff, 0x9f, 0x47, 0x41, 0x20, 0x10, 0x0c, 0x03
	},
	{
		0xc0, 0xb0, 0x88, 0xc4, 0xc2, 0xe2, 0xe1, 0xf1, 0xf1, 0xf9, 0xfa, 0xfe, 0x04, 0x08, 0x30, 0xc0, 0x03, 0x0d, 0x11, 0x23, 0x43, 0x47, 0x87, 0x8f, 0x8f, 0x9f, 0x5f, 0x7f, 0x20, 0x10, 0x0c, 0x03
	}

};

static uint8_t image_data_Tank[2][64] PROGMEM = {
	{
		0xf8, 0x04, 0xf2, 0xe9, 0xe5, 0xe5, 0xe5, 0xe5, 0xe5, 0xe5, 0xa5, 0xe5,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 0xf7
		},
	{
		0xf8, 0x04, 0xf2, 0xe9, 0xe5, 0xe5, 0xe5, 0xe5, 0xe5, 0xe5, 0xe5, 0xa5,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 0xf7
	}
};

void loop()
{
	static uint8_t animate = 0;
	static uint8_t animate_fast = 0;

	glcd.clear();

	// Only got room for this one
	glcd.setFont(font_metric01);
	
	// Draw 5 heat waves - 2 step animation
	for (int i=0;i<5;i++)
		glcd.drawBitmap(1+i*3,0,image_data_Heat[animate%2],2,8,1);

	// Draw 1 radiator
	glcd.drawBitmap(0,8,image_data_Rad,16,16,1);

	// Draw pump - 4 step animation (fast)
	glcd.drawBitmap(108,4,image_data_Pump[animate_fast%4],16,16,1);
	glcd.drawRect(76,2,50,20,WHITE);

	// Power, duty cycle, ambient
	glcd.drawString(78,4,"P:10.2KW");
	glcd.drawString(78,15,"D:45%");
	glcd.drawString(78,23,"A:4.2*");

	// Draw tank - 2 step animation (slow)
	glcd.drawBitmap(0,32,image_data_Tank[animate%2],16,32,1);

	// Horizontal radiator pipes
	glcd.drawLine(16,12,76,12,WHITE);
	glcd.drawLine(16,14,76,14,WHITE);
	glcd.drawLine(16,17,76,17,WHITE);
	glcd.drawLine(16,19,76,19,WHITE);


	// Ambient, flow, return temps
	glcd.drawString(18,0,"A:21.2*");
	glcd.drawString(18,6,"F:54.3*");
	glcd.drawString(18,21,"R:34.2*");

	// flow animation - nasty!
	for (int i=76; i>15; i--)
		if (!(i%3))
			glcd.setPixel((i - (animate)),13, WHITE);

	for (int i=15; i<76; i++)
		if (!(i%3))
			glcd.setPixel((i + (animate)),18, WHITE);

	// "Wall"
	glcd.drawLine(70,0,70,12,WHITE);
	glcd.drawLine(68,0,68,12,WHITE);
	glcd.drawLine(70,14,70,17,WHITE);
	glcd.drawLine(68,14,68,17,WHITE);
	glcd.drawLine(70,19,70,64,WHITE);
	glcd.drawLine(68,19,68,64,WHITE);

	// IN/OUT labels
	glcd.drawString(60,58,"IN");
	glcd.drawString(72,58,"OUT");

	// Vertical pipes
	glcd.drawLine(16,37,50,37,WHITE);
	glcd.drawLine(16,39,52,39,WHITE);
	glcd.drawLine(16,58,55,58,WHITE);
	glcd.drawLine(16,60,57,60,WHITE);

	// Horizontal tank pipes
	glcd.drawLine(50,14,50,37,WHITE);
	glcd.drawLine(52,14,52,39,WHITE);
	glcd.drawLine(55,19,55,58,WHITE);
	glcd.drawLine(57,19,57,60,WHITE);

  	glcd.refresh();

  	animate_fast++;

  	if (animate_fast%4 == 0)
  		animate++;

  	delay(200);
}
